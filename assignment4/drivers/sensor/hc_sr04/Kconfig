## assignment4/drivers/sensor/hc_sr04/Kconfig
```kconfig
# Kconfig - HC_SR04 ultrasonic range sensor

menuconfig HC_SR04
	bool
	prompt "HC_SR04 ultrasonic range sensor"
	depends on GPIO
	default n
	help
	  Enable driver for HC_SR04 ultrasonic range sensor.

config HC_SR04_0_NAME
	string
	prompt "Driver name"
	default "HR-SR04_0"
	depends on HC_SR04
	help
	  Device name with which the HC_SR04 sensor is identified.

config HC_SR04_1_NAME
	string
	prompt "Driver name"
	default "HR-SR04_1"
	depends on HC_SR04
	help
	  Device name with which the HC_SR04 sensor is identified.

config HC_SR04_GPIO_DEV_NAME
	string
	prompt "GPIO device"
	default "GPIO_0"
	depends on HC_SR04
	help
	  The device name of the GPIO device to which the HC_SR04 data-ready
	  pin is connected.

config HC_SR04_0_GPIO_PIN_ECHO
	int
	prompt "Interrupt GPIO pin number"
	default 3
	depends on HC_SR04
	help
	  The number of the GPIO on which the data-ready signal from the HC_SR04
	  chip will be received.

config HC_SR04_0_SHIELD_PIN_ECHO
	int
	prompt "Interrupt GPIO pin number"
	default 0
	depends on HC_SR04
	help
	  The number of the GPIO on which the data-ready signal from the HC_SR04
	  chip will be received.

config HC_SR04_1_GPIO_PIN_ECHO
	int
	prompt "Interrupt GPIO pin number"
	default 4
	depends on HC_SR04
	help
	  The number of the GPIO on which the data-ready signal from the HC_SR04
	  chip will be received.

config HC_SR04_1_SHIELD_PIN_ECHO
	int
	prompt "Interrupt GPIO pin number"
	default 1
	depends on HC_SR04
	help
	  The number of the GPIO on which the data-ready signal from the HC_SR04
	  chip will be received.

config HC_SR04_0_GPIO_PIN_TRIG
	int
	prompt "Interrupt GPIO pin number"
	default 5
	depends on HC_SR04
	help
	  The number of the GPIO on which the data-ready signal from the HC_SR04
	  chip will be received.

config HC_SR04_0_SHIELD_PIN_TRIG
	int
	prompt "Interrupt GPIO pin number"
	default 2
	depends on HC_SR04
	help
	  The number of the GPIO on which the data-ready signal from the HC_SR04
	  chip will be received.

config HC_SR04_1_GPIO_PIN_TRIG
	int
	prompt "Interrupt GPIO pin number"
	default 6
	depends on HC_SR04
	help
	  The number of the GPIO on which the data-ready signal from the HC_SR04
	  chip will be received.

config HC_SR04_1_SHIELD_PIN_TRIG
	int
	prompt "Interrupt GPIO pin number"
	default 3
	depends on HC_SR04
	help
	  The number of the GPIO on which the data-ready signal from the HC_SR04
	  chip will be received.
```
